//
// Created by yushu on 2025/11/23.
//
#include "ssd1306.h"
#include <string.h>
#include <stdio.h>

static uint8_t SSD1306_Buffer[SSD1306_WIDTH * SSD1306_HEIGHT / 8];
static uint8_t CurrentX = 0;
static uint8_t CurrentY = 0;

typedef enum {
    CN_SHI = 0, CN_JIAN, CN_MO, CN_SHI2, CN_DIAN, CN_CHI, CN_ZHUANG, CN_TAI,
    CN_DAI, CN_JI, CN_KAI, CN_HUAN, CN_BI, CN_DI, CN_YA, CN_GONG, CN_ZUO,
    CN_SHOU, CN_WANG, CN_SHANG, CN_WU
} CNGlyphId_t;

// 16x16 Chinese glyphs, 32 bytes per glyph, row-major (2 bytes per row)
static const uint8_t CN12_GLYPHS[][32] = {
    { 0x1F, 0x02, 0x11, 0x02, 0x11, 0x7F, 0x11, 0x02, 0x11, 0x02, 0x1F, 0x02, 0x11, 0x22, 0x11, 0x12, 0x11, 0x12, 0x11, 0x02, 0x1F, 0x02, 0x11, 0x02, 0x00, 0x0A, 0x00, 0x04, 0x00, 0x00, 0x00, 0x00 },
    { 0x04, 0x01, 0x10, 0x01, 0x11, 0xF1, 0x11, 0x11, 0x11, 0x11, 0x11, 0x11, 0x11, 0xF1, 0x11, 0x11, 0x11, 0x11, 0x11, 0x11, 0x11, 0xF1, 0x10, 0x01, 0x10, 0x05, 0x10, 0x02, 0x00, 0x00, 0x00, 0x00 },
    { 0x05, 0xFF, 0x04, 0x44, 0x3F, 0x00, 0x04, 0xFE, 0x0C, 0x82, 0x0E, 0xFE, 0x15, 0x82, 0x14, 0xFE, 0x24, 0x10, 0x05, 0xFF, 0x04, 0x28, 0x04, 0x44, 0x04, 0x82, 0x05, 0x01, 0x00, 0x00, 0x00, 0x00 },
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    { 0x00, 0x80, 0x00, 0x80, 0x00, 0x80, 0x00, 0x80, 0x1F, 0xFF, 0x01, 0x20, 0x01, 0x20, 0x01, 0x20, 0x02, 0x20, 0x02, 0x20, 0x04, 0x21, 0x08, 0x21, 0x10, 0x1F, 0x20, 0x00, 0x00, 0x00, 0x00, 0x00 },
};

static HAL_StatusTypeDef ssd1306_WriteCommand(uint8_t cmd)
{
    uint8_t data[2];
    data[0] = 0x00;
    data[1] = cmd;
    return HAL_I2C_Master_Transmit(SSD1306_I2C, SSD1306_I2C_ADDR, data, 2, 100);
}

static HAL_StatusTypeDef ssd1306_WriteData(const uint8_t *data, uint16_t size)
{
    uint8_t buf[1 + 128];
    if (size > 128) size = 128;

    buf[0] = 0x40;
    memcpy(&buf[1], data, size);

    return HAL_I2C_Master_Transmit(SSD1306_I2C, SSD1306_I2C_ADDR, buf, size + 1, 100);
}

static const uint8_t Font6x8[][6] = {
    {0x00,0x00,0x00,0x00,0x00,0x00}, // space
    {0x3E,0x51,0x49,0x45,0x3E,0x00}, // 0
    {0x00,0x42,0x7F,0x40,0x00,0x00}, // 1
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    {0x00,0x00,0x24,0x00,0x24,0x00}, // :
};

static int font_index_from_char(char c)
{
    if (c == ' ') return 0;
    if (c >= '0' && c <= '9') return 1 + (c - '0');
    if (c == '.') return 11;
    if (c == 'V' || c == 'v') return 12;
    if (c == '%') return 13;
    if (c == ':') return 14;
    return 0;
}

static void ssd1306_DrawPixel(uint8_t x, uint8_t y, uint8_t color)
{
    if (x >= SSD1306_WIDTH || y >= SSD1306_HEIGHT) return;
    uint16_t idx = (uint16_t)x + ((uint16_t)(y / 8u) * SSD1306_WIDTH);
    uint8_t bit = (uint8_t)(1u << (y & 0x7u));
    if (color) SSD1306_Buffer[idx] |= bit;
    else SSD1306_Buffer[idx] &= (uint8_t)(~bit);
}

static void ssd1306_DrawCNGlyph12(uint8_t x, uint8_t y, CNGlyphId_t id)
{
    if ((unsigned)id >= (sizeof(CN12_GLYPHS) / sizeof(CN12_GLYPHS[0]))) return;
    const uint8_t *g = CN12_GLYPHS[(unsigned)id];
    for (uint8_t row = 0; row < 16; ++row) {
        uint16_t bits = (uint16_t)(((uint16_t)g[row * 2] << 8) | g[row * 2 + 1]);
        for (uint8_t col = 0; col < 16; ++col) {
            if (bits & (uint16_t)(1u << (15u - col))) {
                ssd1306_DrawPixel((uint8_t)(x + col), (uint8_t)(y + row), 1);
            }
        }
    }
}

static void ssd1306_DrawCNWord(uint8_t x, uint8_t y, const CNGlyphId_t *ids, uint8_t count)
{
    for (uint8_t i = 0; i < count; ++i) {
        ssd1306_DrawCNGlyph12((uint8_t)(x + i * 17u), y, ids[i]);
    }
}

HAL_StatusTypeDef SSD1306_Init(void)
{
    HAL_Delay(100);

    if (ssd1306_WriteCommand(0xAE) != HAL_OK) return HAL_ERROR;
    if (ssd1306_WriteCommand(0xD5) != HAL_OK) return HAL_ERROR;
    if (ssd1306_WriteCommand(0x80) != HAL_OK) return HAL_ERROR;
    if (ssd1306_WriteCommand(0xA8) != HAL_OK) return HAL_ERROR;
    if (ssd1306_WriteCommand(0x3F) != HAL_OK) return HAL_ERROR;
    if (ssd1306_WriteCommand(0xD3) != HAL_OK) return HAL_ERROR;
    if (ssd1306_WriteCommand(0x00) != HAL_OK) return HAL_ERROR;
    if (ssd1306_WriteCommand(0x40) != HAL_OK) return HAL_ERROR;
    if (ssd1306_WriteCommand(0x8D) != HAL_OK) return HAL_ERROR;
    if (ssd1306_WriteCommand(0x14) != HAL_OK) return HAL_ERROR;
    if (ssd1306_WriteCommand(0x20) != HAL_OK) return HAL_ERROR;
    if (ssd1306_WriteCommand(0x00) != HAL_OK) return HAL_ERROR;
    if (ssd1306_WriteCommand(0xA1) != HAL_OK) return HAL_ERROR;
    if (ssd1306_WriteCommand(0xC8) != HAL_OK) return HAL_ERROR;
    if (ssd1306_WriteCommand(0xDA) != HAL_OK) return HAL_ERROR;
    if (ssd1306_WriteCommand(0x12) != HAL_OK) return HAL_ERROR;
    if (ssd1306_WriteCommand(0x81) != HAL_OK) return HAL_ERROR;
    if (ssd1306_WriteCommand(0xCF) != HAL_OK) return HAL_ERROR;
    if (ssd1306_WriteCommand(0xD9) != HAL_OK) return HAL_ERROR;
    if (ssd1306_WriteCommand(0xF1) != HAL_OK) return HAL_ERROR;
    if (ssd1306_WriteCommand(0xDB) != HAL_OK) return HAL_ERROR;
    if (ssd1306_WriteCommand(0x40) != HAL_OK) return HAL_ERROR;
    if (ssd1306_WriteCommand(0xA4) != HAL_OK) return HAL_ERROR;
    if (ssd1306_WriteCommand(0xA6) != HAL_OK) return HAL_ERROR;
    if (ssd1306_WriteCommand(0xAF) != HAL_OK) return HAL_ERROR;

    SSD1306_Fill(0);
    SSD1306_UpdateScreen();
    return HAL_OK;
}

void SSD1306_Fill(uint8_t color)
{
    memset(SSD1306_Buffer, color ? 0xFF : 0x00, sizeof(SSD1306_Buffer));
}

void SSD1306_UpdateScreen(void)
{
    for (uint8_t page = 0; page < 8; page++) {
        ssd1306_WriteCommand(0xB0 + page);
        ssd1306_WriteCommand(0x00);
        ssd1306_WriteCommand(0x10);

        const uint8_t *ptr = &SSD1306_Buffer[SSD1306_WIDTH * page];
        ssd1306_WriteData(ptr, SSD1306_WIDTH);
    }
}

void SSD1306_GotoXY(uint8_t x, uint8_t y)
{
    CurrentX = x;
    CurrentY = y;
}

static void SSD1306_PutChar(char c)
{
    int idx = font_index_from_char(c);
    const uint8_t *glyph = Font6x8[idx];

    uint8_t page = CurrentY / 8;
    if (page > 7) return;
    if (CurrentX + 6 > SSD1306_WIDTH) return;

    uint16_t base = page * SSD1306_WIDTH + CurrentX;
    for (int i = 0; i < 6; i++) {
        SSD1306_Buffer[base + i] = glyph[i];
    }

    CurrentX += 6;
}

void SSD1306_Puts(const char *s)
{
    while (*s) {
        SSD1306_PutChar(*s++);
    }
}

void SSD1306_ShowDashboard(const SSD1306_DashboardData_t *d)
{
    if (!d) return;

    char tbuf[16];
    char bbuf[20];

    const uint32_t h = d->uptime_s / 3600u;
    const uint32_t m = (d->uptime_s % 3600u) / 60u;
    const uint32_t s = d->uptime_s % 60u;
    snprintf(tbuf, sizeof(tbuf), "%02lu:%02lu:%02lu", (unsigned long)h, (unsigned long)m, (unsigned long)s);

    float pctf = d->battery_pct;
    if (pctf < 0.0f) pctf = 0.0f;
    if (pctf > 100.0f) pctf = 100.0f;
    int pct = (int)(pctf + 0.5f);
    snprintf(bbuf, sizeof(bbuf), "%.2fV %3d%%", d->battery_v, pct);

    const CNGlyphId_t label_time[] = {CN_SHI, CN_JIAN};
    const CNGlyphId_t label_mode[] = {CN_MO, CN_SHI2};
    const CNGlyphId_t label_batt[] = {CN_DIAN, CN_CHI};
    const CNGlyphId_t label_stat[] = {CN_ZHUANG, CN_TAI};

    const CNGlyphId_t mode_idle[] = {CN_DAI, CN_JI};
    const CNGlyphId_t mode_open[] = {CN_KAI, CN_HUAN};
    const CNGlyphId_t mode_close[] = {CN_BI, CN_HUAN};

    const CNGlyphId_t work_run[] = {CN_GONG, CN_ZUO};
    const CNGlyphId_t low_v[] = {CN_DI, CN_YA};

    SSD1306_Fill(0);

    ssd1306_DrawCNWord(0, 0, label_time, 2);
    SSD1306_GotoXY(36, 0);
    SSD1306_Puts(tbuf);

    ssd1306_DrawCNWord(0, 16, label_mode, 2);
    if (d->mode == 0u) ssd1306_DrawCNWord(36, 16, mode_idle, 2);
    else if (d->mode == 1u) ssd1306_DrawCNWord(36, 16, mode_open, 2);
    else ssd1306_DrawCNWord(36, 16, mode_close, 2);

    ssd1306_DrawCNWord(0, 32, label_batt, 2);
    SSD1306_GotoXY(36, 32);
    SSD1306_Puts(bbuf);

    ssd1306_DrawCNWord(0, 48, label_stat, 2);
    if (d->uv_cutoff_active || d->uv_limit_active) {
        ssd1306_DrawCNWord(36, 48, low_v, 2);
    } else if (d->mode == 0u) {
        ssd1306_DrawCNWord(36, 48, mode_idle, 2);
    } else {
        ssd1306_DrawCNWord(36, 48, work_run, 2);
        switch (d->src) {
        case 1u: ssd1306_DrawCNGlyph12(72, 48, CN_SHOU); break;  // PS2
        case 2u: ssd1306_DrawCNGlyph12(72, 48, CN_WANG); break;  // ESP
        case 3u: ssd1306_DrawCNGlyph12(72, 48, CN_SHANG); break; // PC
        default: ssd1306_DrawCNGlyph12(72, 48, CN_WU); break;
        }
    }

    SSD1306_UpdateScreen();
}

void SSD1306_ShowBattery(const BatteryStatus_t *batt)
{
    if (!batt) return;

    char line1[12];
    char line2[12];

    snprintf(line1, sizeof(line1), "%.2fV", batt->voltage);
    int pct = (int)(batt->percent + 0.5f);
    if (pct < 0) pct = 0;
    if (pct > 100) pct = 100;
    snprintf(line2, sizeof(line2), "%3d%%", pct);

    SSD1306_Fill(0);
    SSD1306_GotoXY(0, 0);
    SSD1306_Puts(line1);
    SSD1306_GotoXY(0, 8);
    SSD1306_Puts(line2);
    SSD1306_UpdateScreen();
}
